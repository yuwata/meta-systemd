## conf/layer.conf
```bitbake
# We have a conf and classes directory, add to BBPATH
BBPATH .= ":${LAYERDIR}"

# We have recipes-* directories, add to BBFILES
BBFILES += "${LAYERDIR}/recipes-*/*/*.bb \
            ${LAYERDIR}/recipes-*/*/*.bbappend"

BBFILE_COLLECTIONS += "meta-systemd"
BBFILE_PATTERN_meta-systemd = "^${LAYERDIR}/"
BBFILE_PRIORITY_meta-systemd = "6"

LAYERDEPENDS_meta-systemd = "core"
LAYERSERIES_COMPAT_meta-systemd = "warrior"
```
